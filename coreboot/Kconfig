## coreboot/Kconfig
```kconfig
## SPDX-License-Identifier: GPL-2.0-only

if VENDOR_TECHVISION

choice
	prompt "Mainboard model"

source "src/mainboard/techvision/*/Kconfig.name"

endchoice

source "src/mainboard/techvision/*/Kconfig"

config MAINBOARD_VENDOR
	default "Techvision"

endif # VENDOR_TECHVISION
```

## coreboot/Kconfig.name
```kconfig
## SPDX-License-Identifier: GPL-2.0-only

config BOARD_TECHVISION_TVI7309X
	bool "TVI7309X (BKHD 1338NP-12)"
```
